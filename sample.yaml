## sample.yaml
```yaml
sample:
  name: Button Sample
tests:
  sample.basic.distance:
    tags: button gpio
    filter: dt_enabled_alias_with_parent_compat("in0", "gpio-keys")
    depends_on: gpio
    harness: sensor
```
